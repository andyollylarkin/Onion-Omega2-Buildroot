## board/omega2/Config.in
```kconfig
menu "Omega2 build toolchain"
	config BR2_OMEGA2_BUILD_CTNG_TOOLCHAIN
	      bool "Build toolchain from source via crosstool-NG"
	      help
		Build Omega2 CTNG toolchain from source (use gcc 11.20 mipsel, soft-float, musl)
	config BR2_OMEGA2_CTNG_URL
		depends on BR2_OMEGA2_BUILD_CTNG_TOOLCHAIN
		string "crosstool-NG download URL"
		default "https://github.com/crosstool-ng/crosstool-ng/releases/download/crosstool-ng-1.25.0/crosstool-ng-1.25.0.tar.xz"
endmenu
```

## configs/omega2_defconfig
```kconfig
BR2_mipsel=y
BR2_TOOLCHAIN_EXTERNAL=y
BR2_TOOLCHAIN_EXTERNAL_PATH="/linux-src/board/omega2/toolchain/mipsel-unknown-linux-musl"
BR2_TOOLCHAIN_EXTERNAL_CUSTOM_PREFIX="mipsel-unknown-linux-musl"
BR2_TOOLCHAIN_EXTERNAL_GCC_11=y
BR2_TOOLCHAIN_EXTERNAL_HEADERS_5_16=y
BR2_TOOLCHAIN_EXTERNAL_CUSTOM_MUSL=y
BR2_TOOLCHAIN_EXTERNAL_CXX=y
BR2_TARGET_OPTIMIZATION="-O2"
# BR2_STRIP_strip is not set
BR2_TARGET_GENERIC_HOSTNAME="dan-omega2"
BR2_TARGET_GENERIC_ISSUE="Welcome to Buildroot Omega2"
BR2_LINUX_KERNEL=y
BR2_LINUX_KERNEL_CUSTOM_GIT=y
BR2_LINUX_KERNEL_CUSTOM_REPO_URL="https://github.com/OnionIoT/linux-stable.git"
BR2_LINUX_KERNEL_CUSTOM_REPO_VERSION="openwrt-6.6.93"
BR2_LINUX_KERNEL_PATCH="board/omega2/patches/linux"
BR2_LINUX_KERNEL_USE_CUSTOM_CONFIG=y
BR2_LINUX_KERNEL_CUSTOM_CONFIG_FILE="board/omega2/linux.config"
BR2_LINUX_KERNEL_LZMA=y
BR2_LINUX_KERNEL_DTS_SUPPORT=y
BR2_LINUX_KERNEL_DTB_IS_SELF_BUILT=y
BR2_LINUX_KERNEL_CUSTOM_DTS_DIR="/linux-src/board/omega2/dts"
BR2_PACKAGE_EXFAT=y
BR2_PACKAGE_PYTHON3=y
BR2_PACKAGE_NCURSES_ADDITIONAL_TERMINFO="xterm"
BR2_PACKAGE_BC=y
BR2_PACKAGE_DHCPCD=y
BR2_PACKAGE_DROPBEAR=y
BR2_PACKAGE_ETHTOOL=y
BR2_PACKAGE_IPROUTE2=y
BR2_PACKAGE_IW=y
BR2_PACKAGE_NFTABLES=y
BR2_PACKAGE_NFTABLES_JSON=y
BR2_PACKAGE_NTP=y
BR2_PACKAGE_SOCAT=y
BR2_PACKAGE_SSHPASS=y
BR2_PACKAGE_OPKG=y
BR2_PACKAGE_OPKG_GPG_SIGN=y
BR2_PACKAGE_MKSH=y
BR2_PACKAGE_SUDO=y
BR2_PACKAGE_SHADOW=y
BR2_PACKAGE_SHADOW_BCRYPT=y
BR2_PACKAGE_NANO=y
BR2_TARGET_ROOTFS_CPIO=y
BR2_TARGET_ROOTFS_JFFS2=y
BR2_TARGET_ROOTFS_JFFS2_SUMMARY=y
# BR2_TARGET_ROOTFS_TAR is not set
BR2_PACKAGE_HOST_CA_CERTIFICATES=y
BR2_PACKAGE_HOST_DTC=y
BR2_PACKAGE_HOST_GNUPG2=y
BR2_PACKAGE_HOST_JQ=y
BR2_PACKAGE_HOST_LZMA_ALONE=y
BR2_PACKAGE_HOST_MTD=y
BR2_PACKAGE_HOST_SQUASHFS=y
BR2_PACKAGE_HOST_ZIP=y
BR2_PACKAGE_HOST_ZSTD=y
```

## defconfig
```kconfig
BR2_mipsel=y
BR2_TOOLCHAIN_BUILDROOT_MUSL=y
BR2_KERNEL_HEADERS_6_6=y
BR2_GCC_VERSION_15_X=y
BR2_LINUX_KERNEL=y
BR2_LINUX_KERNEL_CUSTOM_GIT=y
BR2_LINUX_KERNEL_CUSTOM_REPO_URL="https://github.com/OnionIoT/linux-stable.git"
BR2_LINUX_KERNEL_CUSTOM_REPO_VERSION="openwrt-6.6.93"
BR2_LINUX_KERNEL_DEFCONFIG="omega2p"
BR2_LINUX_KERNEL_DTS_SUPPORT=y
BR2_LINUX_KERNEL_DTB_IS_SELF_BUILT=y
```
